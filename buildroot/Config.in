## buildroot/Config.in
```kconfig
source "$BR2_EXTERNAL_CP2CL_PATH/package/cp2cl/Config.in"
source "$BR2_EXTERNAL_CP2CL_PATH/package/uwe5622/Config.in"
```

## buildroot/configs/orangepi_zero2w_defconfig
```kconfig
BR2_aarch64=y
BR2_cortex_a53=y
BR2_TOOLCHAIN_BUILDROOT_GLIBC=y
BR2_KERNEL_HEADERS_6_12=y

BR2_TARGET_GENERIC_HOSTNAME="CarPlayBox"
BR2_TARGET_GENERIC_ISSUE="cp2cl"
BR2_TARGET_GENERIC_GETTY_PORT=""
BR2_SYSTEM_DHCP=""

BR2_INIT_BUSYBOX=y
BR2_ROOTFS_DEVICE_CREATION_DYNAMIC_DEVTMPFS=y
BR2_TARGET_ROOTFS_EXT2=y
BR2_TARGET_ROOTFS_EXT2_4=y
BR2_TARGET_ROOTFS_EXT2_SIZE="64M"
BR2_TARGET_ROOTFS_EXT2_RESBLKS=1
BR2_TARGET_ROOTFS_EXT2_LABEL="rootfs"

BR2_GLOBAL_PATCH_DIR="$(BR2_EXTERNAL_CP2CL_PATH)/patches"

BR2_LINUX_KERNEL=y
BR2_LINUX_KERNEL_CUSTOM_VERSION=y
BR2_LINUX_KERNEL_CUSTOM_VERSION_VALUE="6.18.58"
BR2_LINUX_KERNEL_USE_ARCH_DEFAULT_CONFIG=y
BR2_LINUX_KERNEL_CONFIG_FRAGMENT_FILES="$(BR2_EXTERNAL_CP2CL_PATH)/board/common/kernel.fragment $(BR2_EXTERNAL_CP2CL_PATH)/board/orangepi-zero2w/kernel.fragment"
BR2_LINUX_KERNEL_DTS_SUPPORT=y
BR2_LINUX_KERNEL_INTREE_DTS_NAME="allwinner/sun50i-h618-orangepi-zero2w"
BR2_LINUX_KERNEL_IMAGEGZ=y
BR2_LINUX_KERNEL_NEEDS_HOST_OPENSSL=y
# BR2_LINUX_KERNEL_INSTALL_TARGET is not set

BR2_TARGET_ARM_TRUSTED_FIRMWARE=y
BR2_TARGET_ARM_TRUSTED_FIRMWARE_LATEST_VERSION=y
BR2_TARGET_ARM_TRUSTED_FIRMWARE_PLATFORM="sun50i_h616"

BR2_TARGET_UBOOT=y
BR2_TARGET_UBOOT_BUILD_SYSTEM_KCONFIG=y
BR2_TARGET_UBOOT_LATEST_VERSION=y
BR2_TARGET_UBOOT_BOARD_DEFCONFIG="orangepi_zero2w"
BR2_TARGET_UBOOT_CONFIG_FRAGMENT_FILES="$(BR2_EXTERNAL_CP2CL_PATH)/board/common/uboot.fragment"
BR2_TARGET_UBOOT_NEEDS_DTC=y
BR2_TARGET_UBOOT_NEEDS_PYTHON3=y
BR2_TARGET_UBOOT_NEEDS_PYLIBFDT=y
BR2_TARGET_UBOOT_NEEDS_OPENSSL=y
BR2_TARGET_UBOOT_NEEDS_ATF_BL31=y
BR2_TARGET_UBOOT_CUSTOM_MAKEOPTS="SCP=/dev/null"
BR2_TARGET_UBOOT_FORMAT_CUSTOM=y
BR2_TARGET_UBOOT_FORMAT_CUSTOM_NAME="u-boot-sunxi-with-spl.bin"

BR2_PACKAGE_HOST_UBOOT_TOOLS=y

BR2_PACKAGE_BUSYBOX=y
BR2_PACKAGE_DBUS=y
BR2_PACKAGE_BLUEZ5_UTILS=y
BR2_PACKAGE_BLUEZ5_UTILS_CLIENT=y
BR2_PACKAGE_HOSTAPD=y
BR2_PACKAGE_HOSTAPD_DRIVER_NL80211=y
BR2_PACKAGE_DNSMASQ=y
BR2_PACKAGE_IW=y
BR2_PACKAGE_WIRELESS_REGDB=y

BR2_PACKAGE_UWE5622=y

BR2_PACKAGE_DROPBEAR=y
BR2_PACKAGE_DROPBEAR_CLIENT=y
BR2_PACKAGE_DROPBEAR_DISABLE_REVERSEDNS=y
BR2_PACKAGE_DROPBEAR_SMALL=y
BR2_PACKAGE_CP2CL=y
BR2_PACKAGE_HOST_GENIMAGE=y

BR2_ROOTFS_OVERLAY="$(BR2_EXTERNAL_CP2CL_PATH)/board/common/rootfs-overlay $(BR2_EXTERNAL_CP2CL_PATH)/board/orangepi-zero2w/rootfs-overlay"
BR2_ROOTFS_POST_BUILD_SCRIPT="$(BR2_EXTERNAL_CP2CL_PATH)/board/orangepi-zero2w/post-build.sh"
BR2_ROOTFS_POST_IMAGE_SCRIPT="$(BR2_EXTERNAL_CP2CL_PATH)/board/orangepi-zero2w/post-image.sh"
```

## buildroot/package/cp2cl/Config.in
```kconfig
config BR2_PACKAGE_CP2CL
	bool "cp2cl"
	help
	  CarPlay to CarLife bridge: the binary this repository builds, installed
	  as-is. It is statically linked against musl, so nothing here links
	  against it, and it reads nothing from the rootfs but the kernel's
	  configfs, FunctionFS and the access point's own hostapd.conf.
```

## buildroot/package/uwe5622/Config.in
```kconfig
config BR2_PACKAGE_UWE5622
	bool "uwe5622 (Unisoc UWE5622 radio)"
	depends on BR2_LINUX_KERNEL
	help
	  Out-of-tree driver for the Unisoc (Spreadtrum) UWE5622, the
	  Wi-Fi and Bluetooth combo behind the 20U5622 module on the
	  Orange Pi Zero 2W. Mainline has no driver for the chip and is
	  not likely to get one, so this tree builds the vendor source
	  as a module set:

	    uwe5622_bsp_sdio  the WCN core: SDIO, firmware download
	    sprdwl_ng         cfg80211 Wi-Fi, station and SoftAP
	    sprdbt_tty        Bluetooth as a tty over the same SDIO

	  It is not enough on its own. The device tree has to describe
	  the SDIO bus and the power sequence, and the blobs the WCN
	  core reads by path — wcnmodem.bin and wifi_<chip>_<ant>ant.ini
	  — have to be on the target: see board/zero2w/post-build.sh.

	  https://github.com/armbian/uwe5622
```
